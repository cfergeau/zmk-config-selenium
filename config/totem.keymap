#include "zmk-helpers/key-labels/totem.h"
#define TIMELESS_HRMS

#define SELENIUM_KEYMAP_BINDINGS(LOUT1,  LROW1,  RROW1,  ROUT1, \
                                 LOUT2,  LROW2,  RROW2,  ROUT2, \
                                 LOUT3,  LROW3,  RROW3,  ROUT3, \
                                 LT1, LT2, LT3,  RT3, RT2, RT1) \
          LROW1   RROW1       \
          LROW2   RROW2       \
    LOUT3 LROW3   RROW3 ROUT3 \
    LT1 LT2 LT3   RT3 RT2 RT1

#include <selenium/selenium.keymap>
