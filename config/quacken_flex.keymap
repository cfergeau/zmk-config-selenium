#include "../keymaps/aliases.h" // defines symbols and actions

#define SLN_BASE_LAYER(name, LROW1, RROW1, LROW2, RROW2, LROW3, RROW3, LT1, LT2, LT3, RT3, RT2, RT1) \
    SLN_LAYER(name,                                \
        SLN_LOUT1   LROW1      RROW1   SLN_ROUT1   \
        SLN_LOUT2   LROW2      RROW2   SLN_ROUT2   \
        &kp LSHIFT  LROW3      RROW3   &kp RSHIFT  \
            LT1  LT2  LT3      RT3  RT2  RT1       \
    )

#include "../keymaps/selenium.keymap"
