&base_layer {
  bindings = <SELENIUM_KEYMAP_BINDINGS(
    &kp LTOP   ,  &kp Q  &kp W  &kp F  &kp P  &kp B   ,   &kp J  &kp L  &kp U     &kp Y   &kp SEMI  ,  &kp RTOP   ,
    &kp LHOME  ,  &LH4 A &LH3 R &LH2 S &LH1 T &kp G   ,   &kp M  &RH1 N &RH2 E    &RH3 I  &RH4 O    ,  &kp RHOME  ,
    &kp LSHIFT ,  &kp Z  &kp X  &kp C  &kp D  &kp V   ,   &kp K  &kp H  &kp COMMA &kp DOT &kp FSLH  ,  &kp RSHIFT ,
           LTHUMB_TUCK , LTHUMB_HOME , LTHUMB_REACH   ,   RTHUMB_REACH , RTHUMB_HOME , RTHUMB_TUCK
  )>;
};
