&base_layer {
  display-name = "Base";
  bindings = <SELENIUM_KEYMAP_BINDINGS(
    &kp LTOP   ,  &kp SQT  &kp COMMA &kp DOT &kp P  &kp Y   ,   &kp F  &kp G  &kp C  &kp R  &kp L  ,  &kp RTOP   ,
    &kp LHOME  ,  &LH4 A   &LH3 O    &LH2 E  &LH1 U &kp I   ,   &kp D  &RH1 H &RH2 T &RH3 N &RH4 S ,  &kp RHOME  ,
    &kp LSHIFT ,  &kp SEMI &kp Q     &kp J   &kp K  &kp X   ,   &kp B  &kp M  &kp W  &kp V  &kp Z  ,  &kp RSHIFT ,
                 LTHUMB_TUCK , LTHUMB_HOME , LTHUMB_REACH   ,   RTHUMB_REACH , RTHUMB_HOME , RTHUMB_TUCK
  )>;
};
