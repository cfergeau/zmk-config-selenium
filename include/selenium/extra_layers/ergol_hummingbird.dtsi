#define ODK_LAYER        EXTRA_LAYERS_START_INDEX
#define ODK_SHIFT_LAYER (EXTRA_LAYERS_START_INDEX + 1)
#define EXTRA_SYM_LAYER (EXTRA_LAYERS_START_INDEX + 2)

// The name here and in the keymap below must match the base layer name from selenium.keymap.
// This /delete-node/ directive will ensure we get an error if the name in selenium.keymap does not match the name used here.
/delete-node/ &layer_Base;

// Override the base layer to replace Ergo‑L’s OneDeadKey
SLN_LAYER(Base,
    LROW1_KEYS(&kp Z,  &kp Q,  &kp W,  &kp E,  &kp R,  &kp T),        RROW1_KEYS(&kp N,  &kp U,  &kp I,     &dead_key, &kp P,     &kp FSLH),
    LROW2_KEYS(&kp Z,  HRM_A,  HRM_S,  HRM_D,  HRM_F,  &kp G),        RROW2_KEYS(&kp H,  HRM_J,  HRM_K,     HRM_L,     HRM_SEMI,  &kp FSLH),
    LROW3_KEYS(&none,  &kp Q,  &kp X,  &kp C,  &kp V,  &kp B),        RROW3_KEYS(&kp Y,  &kp M,  &kp COMMA, &kp DOT,   &kp P,     &none),
        LTHUMB_KEYS(LTHUMB_TUCK,  LTHUMB_HOME,  LTHUMB_REACH),    RTHUMB_KEYS(RTHUMB_REACH,  RTHUMB_HOME,  RTHUMB_TUCK)
)

// The name here and in the keymap below must match the Symbols layer name from selenium.keymap.
// This /delete-node/ directive will ensure we get an error if the name in selenium.keymap does not match the name used here.
/delete-node/ &layer_Symbols;

// Override the symbols layer to add a sticky layer to the missing symbols
SLN_LAYER(Symbols,
    LROW1_KEYS(&trans,  S_CARET, S_LT,    S_GT,    S_DLLR,  S_PRCNT),       RROW1_KEYS(S_AT,    S_AMPS,  S_STAR,  S_SQT,   S_GRAVE,  &trans),
    LROW2_KEYS(&trans,  S_LBRC,  S_LPAR,  S_RPAR,  S_RBRC,  S_EQUAL),       RROW2_KEYS(S_BSLH,  S_PLUS,  S_MINUS, S_FSLH,  S_DQT,    &trans),
    LROW3_KEYS(&trans,  S_CARET, S_LBKT,  S_RBKT,  S_UNDER, S_HASH),        RROW3_KEYS(S_PIPE,  S_EXCL,  S_SEMI,  S_COLON, S_GRAVE,  &trans),
    LTHUMB_KEYS(SYM_NUM_LAYER,  &kp SPACE,  &sc EXTRA_SYM_LAYER ENTER),     RTHUMB_KEYS(&trans,  &kp RALT,  &trans)
)

/ {
  behaviors {
    // Swap out the standard dead key for a one-shot layer to override some of the keys
    dead_key: dead_key {
      compatible = "zmk,behavior-mod-morph";
      #binding-cells = <0>;
      bindings = <&EZ_SL(ODK_LAYER)>, <&kp O>;
      mods = <(MOD_LSFT|MOD_RSFT)>;
      keep-mods = <(MOD_LSFT|MOD_RSFT)>;
    };

    // Macro to tap Ergo‑L’s ODK before the specified key
    odk: one_dead_key_macro {
      compatible = "zmk,behavior-macro-one-param";
      #binding-cells = <1>;
      tap-ms = <0>;
      wait-ms = <0>;
      bindings
        = <&macro_tap &kp O>
        , <&macro_param_1to1>
        , <&macro_tap &kp MACRO_PLACEHOLDER>
        ;
    };

    // Same as `odk`, but adds Shift to the speicied key
    odks: one_dead_key_shift_macro {
      compatible = "zmk,behavior-macro-one-param";
      #binding-cells = <1>;
      tap-ms = <0>;
      wait-ms = <0>;
      bindings
        = <&macro_tap &kp O>
        , <&macro_press &kp LSHIFT>
        , <&macro_param_1to1>
        , <&macro_tap &kp MACRO_PLACEHOLDER>
        , <&macro_release &kp LSHIFT>
        ;
    };
  };
};

// Extra layers defned specifically for this keymap.
// They are appended at the end of the base keymap.
SLN_LAYER(OneDeadKey,
    LROW1_KEYS(&trans,  &odk Q,  &odk W,  &odk E,  &odk R,  &kp Z),      RROW1_KEYS(&odk N,  &kp Y,    &odk I,     &odk O,   &odk P,    &trans),
    LROW2_KEYS(&trans,  &odk A,  &odk S,  &odk D,  &odk F,  &kp B),      RROW2_KEYS(&odk H,  &odk J,   &odk K,     &odk L,   &odk SEMI, &trans),
    LROW3_KEYS(&trans,  &odk Q,  &odk Z,  &odk C,  &odk V,  &trans),     RROW3_KEYS(&trans,  &kp FSLH, &odk COMMA, &odk DOT, &odk P,    &trans),
       LTHUMB_KEYS(&EZ_SL(ODK_SHIFT_LAYER),  &odk SPACE,  &trans),     RTHUMB_KEYS(&trans,  &odk SPACE,  &trans)
)

SLN_LAYER(ShiftedOneDeadKey,
    LROW1_KEYS(&trans,   &odks Q,  &odks W,  &odks E,  &odks R,  &kp LS(Z)),      RROW1_KEYS(&odks N,  &kp LS(Y),    &odks I,     &odks O,   &odks P,    &trans),
    LROW1_KEYS(&trans,   &odks A,  &odks S,  &odks D,  &odks F,  &kp LS(B)),      RROW2_KEYS(&odks H,  &odks J,      &odks K,     &odks L,   &odks SEMI, &trans),
    LROW1_KEYS(&trans,   &odks Q,  &odks Z,  &odks C,  &odks V,  &trans),         RROW3_KEYS(&trans,   &kp LS(FSLH), &odks COMMA, &odks DOT, &odks P,    &trans),
                        LTHUMB_KEYS(&trans,   &odks SPACE,  &trans),      RTHUMB_KEYS(&trans,   &odks SPACE,  &trans)
)

SLN_LAYER(ExtraSymbols,
    LROW1_KEYS(&trans,  &trans,  &trans,  &trans,  &trans,  &trans),     RROW1_KEYS(&trans,  &trans,  &trans,  &trans,  &trans,  &trans),
    LROW2_KEYS(&trans,  S_TILDE, &trans,  &trans,  S_HASH,  &trans),     RROW2_KEYS(&trans,  S_PIPE,  &trans,  &trans,  S_QMARK, &trans),
    LROW3_KEYS(&trans,  &trans,  &trans,  &trans,  &trans,  &trans),     RROW3_KEYS(&trans,  &trans,  &trans,  &trans,  &trans,  &trans),
                            LTHUMB_KEYS(&trans,  &trans,  &trans),     RTHUMB_KEYS(&trans,  &trans,  &trans)
)
