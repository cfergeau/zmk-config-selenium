#define DK_LAYER EXTRA_LAYERS_START_INDEX

// The name here and in the keymap below must match the base layer name from selenium.keymap.
// This /delete-node/ directive will ensure we get an error if the name in selenium.keymap does not match the name used here.
/delete-node/ &layer_Base;

SLN_LAYER(Base,
    LROW1_KEYS(&kp TAB,    &kp Q, &kp W, &kp E, &kp R, &kp T),   RROW1_KEYS(&kp Y,  &kp U,  &kp I,     &kp O,   &kp P,      &kp BACKSPACE),
    LROW2_KEYS(&kp ESCAPE, HRM_A, HRM_S, HRM_D, HRM_F, &kp G),   RROW2_KEYS(&kp H,  HRM_J,  HRM_K,     HRM_L,   HRM_SEMI,   &EZ_SL(DK_LAYER)),
    LROW3_KEYS(&kp LSHIFT, &kp Z, &kp X, &kp C, &kp V, &kp B),   LROW3_KEYS(&kp N,  &kp M,  &kp COMMA, &kp DOT, &kp FSLH,   &kp RSHIFT),
           LTHUMB_KEYS(LTHUMB_TUCK,  LTHUMB_HOME,  LTHUMB_REACH),    RTHUMB_KEYS(RTHUMB_REACH,  RTHUMB_HOME,  RTHUMB_TUCK)
)

/ {
  macros {
    kpc: circumflex {
      compatible = "zmk,behavior-macro-one-param";
      #binding-cells = <1>;
      tap-ms = <0>;
      wait-ms = <0>;
      bindings
        = <&macro_tap &kp LBKT>
        , <&macro_pause_for_release>
        , <&macro_param_1to1>
        , <&kp MACRO_PLACEHOLDER>
        ;
    };
    spc: space_after_dk {
      compatible = "zmk,behavior-macro-one-param";
      #binding-cells = <1>;
      tap-ms = <0>;
      wait-ms = <0>;
      bindings
        = <&macro_param_1to1>
        , <&kp MACRO_PLACEHOLDER>
        , <&macro_pause_for_release>
        , <&macro_tap &kp SPACE>
        ;
    };
  };
};

// Extra layers defined specifically for this keymap, appended to the base keymap.
SLN_LAYER(DeadKey,
    LROW1_KEYS(&trans,    &kp N0,  &kp N2,  &kp N7,  &kp RA(E), &trans),     RROW1_KEYS(&trans,  &kp SQT, &trans,  &trans,  &trans,       &trans),
    LROW2_KEYS(&trans,    &kpc Q,  &trans,  &kpc E,  &kp N6,  &kp N8),       RROW2_KEYS(&trans,  &kpc U,  &kpc I,  &kpc O,  &trans,       &trans),
    LROW3_KEYS(&trans,    &trans,  &trans,  &kp N9,  &kp N5,  &kp MINUS),    RROW3_KEYS(&trans,  &trans,  &trans,  &trans,  &kp LS(FSLH), &kp LS(LBKT)),
                         LTHUMB_KEYS(&trans,  &kp N4,  &trans),       RTHUMB_KEYS(&trans,  &kp N4,  &trans)
)
